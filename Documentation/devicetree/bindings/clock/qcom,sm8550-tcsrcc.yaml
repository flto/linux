## Documentation/devicetree/bindings/clock/qcom,sm8550-tcsrcc.yaml
```yaml
# SPDX-License-Identifier: (GPL-2.0-only OR BSD-2-Clause)
%YAML 1.2
---
$id: http://devicetree.org/schemas/clock/qcom,sm8550-tcsrcc.yaml#
$schema: http://devicetree.org/meta-schemas/core.yaml#

title: Qualcomm TCSR Clock Controller on SM8550

maintainers:
  - Bjorn Andersson <andersson@kernel.org>

description: |
  Qualcomm TCSR clock control module provides the clocks, resets and
  power domains on SM8550

  See also:: include/dt-bindings/clock/qcom,sm8550-tcsrcc.h

allOf:
  - $ref qcom,gcc.yaml#

properties:
  compatible:
    const: qcom,sm8550-tcsrcc

required:
  - compatible

additionalProperties: false

examples:
  - |
    clock-controller@1fc0000 {
      compatible = "qcom,sm8550-tcsrcc";
      reg = <0x1fc0000 0x30000>;
      #clock-cells = <1>;
      #reset-cells = <1>;
    };

...
```

## Documentation/devicetree/bindings/display/msm/dp.txt
```
Qualcomm Technologies, Inc.
DP is the master Display Port device which supports DP host controllers that are compatible with VESA Display Port interface specification.
DP Controller: Required properties:
- compatible:           Should be "qcom,dp-display".
- reg:                  Base address and length of DP hardware's memory mapped regions.
- cell-index:           Specifies the controller instance.
- reg-names:            A list of strings that name the list of regs.
			"dp_ahb" - DP controller memory region.
			"dp_aux" - DP AUX memory region.
			"dp_link" - DP link layer memory region.
			"dp_p0" - DP pixel clock domain memory region.
			"dp_phy" - DP PHY memory region.
			"dp_ln_tx0" - USB3 DP PHY combo TX-0 lane memory region.
			"dp_ln_tx1" - USB3 DP PHY combo TX-1 lane memory region.
			"dp_mmss_cc" - Display Clock Control memory region.
			"qfprom_physical" - QFPROM Phys memory region.
			"dp_pll" - USB3 DP combo PLL memory region.
			"usb3_dp_com" - USB3 DP PHY combo memory region.
			"hdcp_physical" - DP HDCP memory region.
- interrupt-parent	phandle to the interrupt parent device node.
- interrupts:		The interrupt signal from the DP block.
- clocks:               Clocks required for Display Port operation. See [1] for details on clock bindings.
- clock-names:          Names of the clocks corresponding to handles. Following clocks are required:
			"core_aux_clk", "core_usb_ref_clk_src","core_usb_ref_clk", "core_usb_cfg_ahb_clk",
			"core_usb_pipe_clk", "ctrl_link_clk", "ctrl_link_iface_clk", "ctrl_crypto_clk",
			"ctrl_pixel_clk", "pixel_clk_rcg", "pixel_parent".
- pll-node:		phandle to DP PLL node.
- vdda-1p2-supply:		phandle to vdda 1.2V regulator node.
- vdda-0p9-supply:		phandle to vdda 0.9V regulator node.
- qcom,aux-cfg0-settings:		Specifies the DP AUX configuration 0 settings. The first
					entry in this array corresponds to the register offset
					within DP AUX, while the remaining entries indicate the
					programmable values.
- qcom,aux-cfg1-settings:		Specifies the DP AUX configuration 1 settings. The first
					entry in this array corresponds to the register offset
					within DP AUX, while the remaining entries indicate the
					programmable values.
- qcom,aux-cfg2-settings:		Specifies the DP AUX configuration 2 settings. The first
					entry in this array corresponds to the register offset
					within DP AUX, while the remaining entries indicate the
					programmable values.
- qcom,aux-cfg3-settings:		Specifies the DP AUX configuration 3 settings. The first
					entry in this array corresponds to the register offset
					within DP AUX, while the remaining entries indicate the
					programmable values.
- qcom,aux-cfg4-settings:		Specifies the DP AUX configuration 4 settings. The first
					entry in this array corresponds to the register offset
					within DP AUX, while the remaining entries indicate the
					programmable values.
- qcom,aux-cfg5-settings:		Specifies the DP AUX configuration 5 settings. The first
					entry in this array corresponds to the register offset
					within DP AUX, while the remaining entries indicate the
					programmable values.
- qcom,aux-cfg6-settings:		Specifies the DP AUX configuration 6 settings. The first
					entry in this array corresponds to the register offset
					within DP AUX, while the remaining entries indicate the
					programmable values.
- qcom,aux-cfg7-settings:		Specifies the DP AUX configuration 7 settings. The first
					entry in this array corresponds to the register offset
					within DP AUX, while the remaining entries indicate the
					programmable values.
- qcom,aux-cfg8-settings:		Specifies the DP AUX configuration 8 settings. The first
					entry in this array corresponds to the register offset
					within DP AUX, while the remaining entries indicate the
					programmable values.
- qcom,aux-cfg9-settings:		Specifies the DP AUX configuration 9 settings. The first
					entry in this array corresponds to the register offset
					within DP AUX, while the remaining entries indicate the
					programmable values.
- qcom,max-pclk-frequency-khz:		An integer specifying the maximum. pixel clock in KHz supported by Display Port.
- qcom,max-lanes-for-dp:		Maximum number of lanes that can be used for Display port.
- qcom,<type>-supply-entries:		A node that lists the elements of the supply used by the a particular "type" of DP module. The module "types"
					can be "core", "ctrl", and "phy". Within the same type,
					there can be more than one instance of this binding,
					in which case the entry would be appended with the
					supply entry index.
					e.g. qcom,ctrl-supply-entry@0
					-- qcom,supply-name: name of the supply (vdd/vdda/vddio)
					-- qcom,supply-min-voltage: minimum voltage level (uV)
					-- qcom,supply-max-voltage: maximum voltage level (uV)
					-- qcom,supply-enable-load: load drawn (uA) from enabled supply
					-- qcom,supply-disable-load: load drawn (uA) from disabled supply
					-- qcom,supply-pre-on-sleep: time to sleep (ms) before turning on
					-- qcom,supply-post-on-sleep: time to sleep (ms) after turning on
					-- qcom,supply-pre-off-sleep: time to sleep (ms) before turning off
					-- qcom,supply-post-off-sleep: time to sleep (ms) after turning off
- pinctrl-names:	List of names to assign mdss pin states defined in pinctrl device node
					Refer to pinctrl-bindings.txt
- pinctrl-<0..n>:	Lists phandles each pointing to the pin configuration node within a pin
					controller. These pin configurations are installed in the pinctrl
					device node. Refer to pinctrl-bindings.txt
DP Endpoint properties:
  - remote-endpoint: For port@0, set to phandle of the connected panel/bridge's
    input endpoint. For port@1, set to the DPU interface output. See [2] for
    device graph info.

Optional properties:
- qcom,aux-en-gpio:		Specifies the aux-channel enable gpio.
- qcom,aux-sel-gpio:		Specifies the mux-selection that might be needed for aux interface.


DP PLL: Required properties:
- compatible:           Should be "qcom,dp-pll-10nm".
- reg:                  Base address and length of DP hardware's memory mapped regions.
- cell-index:           Specifies the PLL instance.
- reg-names:            A list of strings that name the list of regs.
			"pll_base" - DP PLL memory region.
			"phy_base" - DP PHY memory region.
			"ln_tx0_base" - USB3 DP PHY combo TX-0 lane memory region.
			"ln_tx1_base" - USB3 DP PHY combo TX-1 lane memory region.
			"gdsc_base" - gdsc memory region.
- interrupt-parent	phandle to the interrupt parent device node.
- interrupts:		The interrupt signal from the DP block.
- clocks:               Clocks required for Display Port operation. See [1] for details on clock bindings.
- clock-names:          Names of the clocks corresponding to handles. Following clocks are required:
			"iface_clk", "ref_clk", cfg_ahb_clk", "pipe_clk".
- clock-rate:           Initial clock rate to be configured. For the shared clocks, the default value			     is set to zero so that minimum clock value is configured. Non-zero clock
			value can be used to configure DP pixel clock.


[1] Documentation/devicetree/bindings/clock/clock-bindings.txt
[2] Documentation/devicetree/bindings/graph.txt

Example:
	msm_dp: dp_display@ae90000{
		cell-index = <0>;
		compatible = "qcom,dp-display";

		reg =   <0 0x90000 0x0dc>,
			<0 0x90200 0x0c0>,
			<0 0x90400 0x508>,
			<0 0x90a00 0x094>,
			<1 0xeaa00 0x200>,
			<1 0xea200 0x200>,
			<1 0xea600 0x200>,
			<2 0x02000 0x1a0>,
			<3 0x00000 0x621c>,
			<1 0xea000 0x180>,
			<1 0xe8000 0x20>,
			<4 0xe1000 0x034>;
		reg-names = "dp_ahb", "dp_aux", "dp_link",
			"dp_p0", "dp_phy", "dp_ln_tx0", "dp_ln_tx1",
			"dp_mmss_cc", "qfprom_physical", "dp_pll",
			"usb3_dp_com", "hdcp_physical";

		interrupt-parent = <&display_subsystem>;
		interrupts = <12 0>;

		extcon = <&usb_1_ssphy>;
		clocks =  <&dispcc DISP_CC_MDSS_DP_AUX_CLK>,
			<&rpmhcc RPMH_CXO_CLK>,
			<&gcc GCC_USB3_PRIM_CLKREF_CLK>,
			<&gcc GCC_USB_PHY_CFG_AHB2PHY_CLK>,
			<&gcc GCC_USB3_PRIM_PHY_PIPE_CLK>,
			<&dispcc DISP_CC_MDSS_DP_LINK_CLK>,
			<&dispcc DISP_CC_MDSS_DP_LINK_INTF_CLK>,
			<&dispcc DISP_CC_MDSS_DP_PIXEL_CLK>,
			<&dispcc DISP_CC_MDSS_DP_CRYPTO_CLK>,
			<&dispcc DISP_CC_MDSS_DP_PIXEL_CLK_SRC>;
		clock-names = "core_aux_clk", "core_ref_clk_src",
			"core_usb_ref_clk", "core_usb_cfg_ahb_clk",
			"core_usb_pipe_clk", "ctrl_link_clk",
			"ctrl_link_iface_clk", "ctrl_pixel_clk",
			"crypto_clk", "pixel_clk_rcg";

		pll-node = <&dp_pll>;
		vdda-1p2-supply = <&vreg_l3c_1p2>;
		vdda-0p9-supply = <&vreg_l4a_0p8>;
		qcom,aux-cfg0-settings = [20 00];
		qcom,aux-cfg1-settings = [24 13 23 1d];
		qcom,aux-cfg2-settings = [28 24];
		qcom,aux-cfg3-settings = [2c 00];
		qcom,aux-cfg4-settings = [30 0a];
		qcom,aux-cfg5-settings = [34 26];
		qcom,aux-cfg6-settings = [38 0a];
		qcom,aux-cfg7-settings = [3c 03];
		qcom,aux-cfg8-settings = [40 bb];
		qcom,aux-cfg9-settings = [44 03];

		qcom,max-pclk-frequency-khz = <675000>;
		qcom,max-lanes-for-dp = <2>;

		qcom,ctrl-supply-entries {
			#address-cells = <1>;
			#size-cells = <0>;

			qcom,ctrl-supply-entry@0 {
				reg = <0>;
				qcom,supply-name = "vdda-1p2";
				qcom,supply-min-voltage = <1200000>;
				qcom,supply-max-voltage = <1200000>;
				qcom,supply-enable-load = <21800>;
				qcom,supply-disable-load = <4>;
			};
		};

		qcom,phy-supply-entries {
			#address-cells = <1>;
			#size-cells = <0>;

			qcom,phy-supply-entry@0 {
				reg = <0>;
				qcom,supply-name = "vdda-0p9";
				qcom,supply-min-voltage = <880000>;
				qcom,supply-max-voltage = <880000>;
				qcom,supply-enable-load = <36000>;
				qcom,supply-disable-load = <32>;
			};
		};

		ports {
			#address-cells = <1>;
			#size-cells = <0>;

			port@0 {
				reg = <0>;
				dp_in: endpoint {
					remote-endpoint = <&dpu_intf0_out>;
				};
			};

			port@1 {
				reg = <1>;
				dp_out: endpoint {
				};
			};
		};
	};

	dp_pll: dp-pll@c011000 {
		compatible = "qcom,dp-pll-10nm";
		label = "DP PLL";
		cell-index = <0>;
		#clock-cells = <1>;

		reg = <1 0xea000 0x200>,
		      <1 0xeaa00 0x200>,
		      <1 0xea200 0x200>,
		      <1 0xea600 0x200>,
		      <2 0x03000 0x8>;
		reg-names = "pll_base", "phy_base", "ln_tx0_base",
			"ln_tx1_base", "gdsc_base";

		clocks = <&dispcc DISP_CC_MDSS_AHB_CLK>,
			 <&gcc GCC_USB3_PRIM_CLKREF_CLK>,
			 <&gcc GCC_USB_PHY_CFG_AHB2PHY_CLK>,
			 <&gcc GCC_USB3_PRIM_PHY_PIPE_CLK>;
		clock-names = "iface_clk", "ref_clk",
			"cfg_ahb_clk", "pipe_clk";
		clock-rate = <0>;

	};
```

## Documentation/devicetree/bindings/interconnect/qcom,sc7180.txt
```
QTI SC7180 Network-On-Chip interconnect driver binding
-----------------------------------------------------------

SC7180 interconnect providers support system bandwidth requirements through
RPMh hardware accelerators known as Bus Clock Manager (BCM). The provider is
able to communicate with the BCM through the Resource State Coordinator (RSC)
associated with each execution environment. Provider nodes must reside within
an RPMh device node pertaining to their RSC and each provider maps to a single
RPMh resource.

Required properties :
- compatible : shall contain only one of the following:
			"qcom,sc7180-aggre1_noc",
			"qcom,sc7180-aggre2_noc",
			"qcom,sc7180-camnoc_virt",
			"qcom,sc7180-compute_noc",
			"qcom,sc7180-config_noc",
			"qcom,sc7180-dc_noc",
			"qcom,sc7180-gem_noc",
			"qcom,sc7180-ipa_virt",
			"qcom,sc7180-mc_virt",
			"qcom,sc7180-mmss_noc",
			"qcom,sc7180-npu_noc",
			"qcom,sc7180-qup_virt",
			"qcom,sc7180-system_noc".
- #interconnect-cells : should contain 1

Examples:

apps_rsc: rsc {
	snoc: interconnect {
		compatible = "qcom,sc7180-system_noc";
		#interconnect-cells = <1>;
	};
};
```

## Documentation/devicetree/bindings/interconnect/qcom,sm8250.yaml
```yaml
# SPDX-License-Identifier: (GPL-2.0 OR BSD-2-Clause)
%YAML 1.2
---
$id: http://devicetree.org/schemas/interconnect/qcom,sm8250.yaml#
$schema: http://devicetree.org/meta-schemas/core.yaml#

title:  Qualcomm SM8250 Network-On-Chip Interconnect

maintainers:
  - Jonathan Marek <jonathan@marek.ca>

description: |
   SM8250 interconnect providers support system bandwidth requirements through
   RPMh hardware accelerators known as Bus Clock Manager (BCM). The provider is
   able to communicate with the BCM through the Resource State Coordinator (RSC)
   associated with each execution environment. Provider nodes must point to at
   least one RPMh device child node pertaining to their RSC and each provider
   can map to multiple RPMh resources.

properties:
  reg:
    maxItems: 1

  compatible:
    enum:
      - qcom,sm8250-aggre1-noc
      - qcom,sm8250-aggre2-noc
      - qcom,sm8250-compute-noc
      - qcom,sm8250-config-noc
      - qcom,sm8250-dc-noc
      - qcom,sm8250-gem-noc
      - qcom,sm8250-ipa-virt
      - qcom,sm8250-mc-virt
      - qcom,sm8250-mmss-noc
      - qcom,sm8250-npu-noc
      - qcom,sm8250-system-noc
      - qcom,sm8250-gem-noc-display
      - qcom,sm8250-mc-virt-display
      - qcom,sm8250-mmss-noc-display

  '#interconnect-cells':
    const: 1

  qcom,bcm-voters:
    $ref: /schemas/types.yaml#/definitions/phandle-array
    description: |
      List of phandles to qcom,bcm-voter nodes that are required by
      this interconnect to send RPMh commands.

  qcom,bcm-voter-names:
    $ref: /schemas/types.yaml#/definitions/string-array
    description: |
      Names for each of the qcom,bcm-voters specified.

required:
  - compatible
  - reg
  - '#interconnect-cells'
  - qcom,bcm-voters

additionalProperties: false

examples:
  - |
      #include <dt-bindings/interconnect/qcom,sm8250.h>

      config_noc: interconnect@1500000 {
            compatible = "qcom,sm8250-config-noc";
            reg = <0 0x01500000 0 0x1000>;
            #interconnect-cells = <1>;
            qcom,bcm-voters = <&apps_bcm_voter>;
      };

      system_noc: interconnect@1632000 {
            compatible = "qcom,sm8250-system-noc";
            reg = <0 0x01632000 0 0x1000>;
            #interconnect-cells = <1>;
            qcom,bcm-voters = <&apps_bcm_voter>;
      };

      mmss_noc: interconnect@174a000 {
            compatible = "qcom,sm8250-mmss-noc";
            reg = <0 0x0174a000 0 0x1000>;
            #interconnect-cells = <1>;
            qcom,bcm-voters = <&apps_bcm_voter>;
      };
```

## drivers/gpu/drm/bridge/cdn-hdp/Kconfig
```kconfig
config DRM_IMX_HDP
	tristate "IMX8 HD Display Controller"
	select DRM_IMX
	select DRM_KMS_HELPER
	select VIDEOMODE_HELPERS
	select DRM_PANEL
	help
	  Choose this if you want to use DP/HDMI on i.MX8.
```
